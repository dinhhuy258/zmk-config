// Map extra keys
#define _LHX  &none
#define _RHX  &none
#define _LTX
#define _LMX
#define _LBX
#define _RTX
#define _RMX
#define _RBX

#include "zmk-helpers/key-labels/36.h"
#include "base.keymap"

// Use the five column layout for corne
ZMK_APPLY_MATRIX_TRANSFORM(five_column_transform)
