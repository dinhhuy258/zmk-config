/ {
  behaviors {
    ht: hold_tap {
      label = "hold_tap";
      compatible = "zmk,behavior-hold-tap";
      #binding-cells = <2>;
      flavor = "tap-preferred";
      tapping-term-ms = <200>;
      quick-tap-ms = <200>;
      bindings = <&kp>, <&kp>;
    };
  };
};
